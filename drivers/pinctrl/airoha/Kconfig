## drivers/pinctrl/airoha/Kconfig
```kconfig
# SPDX-License-Identifier: GPL-2.0-only

config PINCTRL_AIROHA
	depends on ARCH_AIROHA
	select PINCTRL_FULL
	select PINCTRL_GENERIC
	select PINMUX
	select PINCONF
	select REGMAP
	select SYSCON
	bool
```
