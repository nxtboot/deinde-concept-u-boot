## arch/arm/mach-rockchip/rv1103b/Kconfig
```kconfig
if ROCKCHIP_RV1103B

config ROCKCHIP_BOOT_MODE_REG
	default 0x20160200

config ROCKCHIP_STIMER_BASE
	default 0x20500000

config SYS_SOC
	default "rv1103b"

config SYS_MALLOC_F_LEN
	default 0x400

endif
```

## arch/arm/mach-rockchip/rv1106/Kconfig
```kconfig
if ROCKCHIP_RV1106

config TARGET_LUCKFOX_PICO_RV1103
	bool "LUCKFOX_PICO_RV1103"
	help
	  Support Luckfox's Pico series of RV1103 boards, such as the Pico
	  Mini B. These are small, low-cost boards with 64MB of in-package
	  DDR2, a microSD slot and a USB-C port used for both power and
	  maskrom-mode USB download; most I/O is on castellated edge pins.
	  The Mini B adds a 128MB Winbond SPI NAND, from which it boots.
	  U-Boot can also run entirely from RAM over USB, with nothing
	  written to the flash.

config ROCKCHIP_BOOT_MODE_REG
	default 0xff020200

config ROCKCHIP_STIMER_BASE
	default 0xff590020

config SYS_SOC
	default "rv1106"

config SYS_MALLOC_F_LEN
	default 0x400

source "board/luckfox/pico/Kconfig"

endif
```

## arch/x86/cpu/alderlake/Kconfig
```kconfig
# SPDX-License-Identifier: GPL-2.0
#
# Copyright 2026 Simon Glass <sjg@chromium.org>

config INTEL_ALDERLAKE
	bool
	select HAVE_FSP
	select ARCH_MISC_INIT
	imply MRC_CACHE_SAVE
	imply SPL_MRC_CACHE_SAVE
	imply PINCTRL_INTEL
	imply PINCTRL_INTEL_ALDERLAKE
	imply INTEL_GPIO
	imply CLK
	imply CLK_INTEL
	imply ACPI_GPE
	imply P2SB
	imply HAVE_P2SB
	imply HAVE_ITSS
	select INTEL_SOC
	select TPL_X86_TSC_TIMER_NATIVE
	select PCIEX_LENGTH_256MB
	select TPL_OF_PLATDATA_PARENT
	select TPL_OF_PLATDATA_INST
	select TPL_READ_ONLY
	imply TPL
	imply SPL
	imply TPL_X86_16BIT_INIT
	imply TPL_OF_PLATDATA
	imply HAVE_X86_FIT
	help
	  Alder Lake is a hybrid (P- and E-core) SoC from Intel, launched in
	  2021 as 12th-generation Core. This supports running U-Boot natively
	  on Alder Lake-P devices such as brya-class Chromebooks: TPL sets up
	  Cache-as-RAM using FSP-T and runs execute-in-place from the SPI
	  flash, then SPL performs memory init with FSP-M

	  Note that USE_CAR is deliberately not selected: FSP-T's TempRamInit
	  decides where Cache-as-RAM lives and reports it back, so car.S sets
	  the stack from that, rather than from SYS_CAR_ADDR/SYS_CAR_SIZE

if INTEL_ALDERLAKE

config FSP2_PWRM_BASE
	default 0xfe000000

config MMCONF_BASE_ADDRESS
	hex
	default 0xc0000000

config PCR_BASE_ADDRESS
	hex
	default 0xfd000000
	help
	  Base address for the Private Configuration Register (PCR) space,
	  used to access GPIO and other devices over the P2SB sideband. This
	  is programmed into the P2SB SBREG BAR early in boot

config FSP_T_ADDR
	hex
	default 0xfff1f000
	help
	  Flash-mapped address of the FSP-T binary, which must match the
	  ImageBase it is linked for, since it executes in place

config FSP_T_ENTRY_OFFSET
	hex
	default 0x3e3
	help
	  Offset of the TempRamInit entry point within the FSP-T binary, from
	  the TempRamInitEntryOffset field of its FSP_INFO_HEADER (shown by
	  SplitFspBin.py info). Used directly since there is no stack, and so
	  no easy way to parse the header, before TempRamInit is called

config FSP_CODE_REGION_BASE
	hex
	default 0
	help
	  Base address of the region which FSP-T sets up to be cached for
	  execute-in-place code, or 0 to cache the top FSP_CODE_REGION_SIZE
	  of the address space, which is the part of the SPI flash that the
	  PCH maps below 4GB. A non-zero base makes FSP-T cache upwards from
	  that address for as much LLC as is available, which misses the
	  code at the top of flash, so 0 is the useful setting.

config FSP_CODE_REGION_SIZE
	hex
	default 0x400000
	help
	  Size of the execute-in-place code region (see FSP_CODE_REGION_BASE).
	  The FSP's own default for this is zero, which makes TempRamInit
	  fail, so a real size must be provided

config FSP_M_ADDR
	hex
	default 0xffe5f000
	help
	  Flash-mapped address of the FSP-M binary, matching its ImageBase so
	  that it can execute in place during memory init

config FSP_S_ADDR
	hex
	default 0xffe00000
	help
	  Flash-mapped address of the FSP-S binary

config TPL_SIZE_LIMIT
	default 0x3b000

config DCACHE_RAM_BASE
	default 0xfef00000

config DCACHE_RAM_SIZE
	default 0xc0000

endif
```

## arch/x86/cpu/turin/Kconfig
```kconfig
# SPDX-License-Identifier: GPL-2.0+
#
# Copyright 2026 Simon Glass <sjg@chromium.org>

config ARCH_AMD_TURIN
	bool
	select X86_RESET_VECTOR
	select X86_TSC_TIMER
	select SYS_NS16550
	select SYS_NS16550_PORT_MAPPED
	select DEBUG_UART_BOARD_INIT if DEBUG_UART
	select ARCH_EARLY_INIT_R
	select PHYS_64BIT
	select SYS_PCI_64BIT
	select DDR5_SPD
	imply SYSINFO
	imply SYSINFO_SMBIOS
	imply SMBIOS_MEMORY_SYSINFO
	imply PCI_INIT_R
	imply AHCI_PCI
	imply SCSI
	imply SCSI_AHCI
	imply CMD_SCSI
	imply NVME_PCI
	imply CMD_NVME
	imply USB
	imply USB_XHCI_HCD
	imply USB_XHCI_PCI
	imply USB_STORAGE
	imply CMD_USB
	imply BNXT_ETH
	imply GENERATE_MP_TABLE
	imply GENERATE_ACPI_TABLE
	help
	  AMD EPYC 9005 (Turin) SoC. The PSP trains the memory and releases
	  the x86 cores from a reset vector in DRAM, at the top of the 'BIOS
	  reset image' it has decompressed there from the flash, so U-Boot
	  runs from DRAM from its first instruction and needs no SPL.

if ARCH_AMD_TURIN

config SYS_CAR_ADDR
	hex
	default 0x07000000
	help
	  There is no cache-as-RAM on this SoC since DRAM is up before the
	  x86 cores start; this is simply the early stack region, below the
	  APOB which the PSP leaves at 0x7010000.

config SYS_CAR_SIZE
	hex
	default 0x10000

config TURIN_IMAGE_ADDR
	hex "Address of the image holding U-Boot and the microcode"
	help
	  Without SPL, the PSP copies the whole of U-Boot's image, microcode
	  patches included, into DRAM, so this is the same as CONFIG_PPL_TEXT_BASE
	  in that case. The PSP only starts a small BIOS image, though, so a
	  larger U-Boot needs SPL as the BIOS image, with U-Boot proper and
	  the microcode patches elsewhere in the flash. This is then the
	  address of the flash image in memory, where SPL copies U-Boot from
	  and where U-Boot finds the microcode.

config TURIN_REG_TRACE
	bool "Trace the register writes and firmware messages of the bring-up"
	depends on DEBUG_UART
	help
	  Print every SMN, PCI-configuration, MMIO and MSR write, and every
	  message to the SMU and MPIO firmware, on the debug UART as the
	  processor is brought up, one line each in the form that openSIL
	  prints with the same hooks. The two traces can then be compared to
	  find what one firmware sets up and the other does not. This is for
	  bring-up only: the output is large and slows the boot.

config TURIN_OPENSIL
	bool "Build and link AMD's openSIL library"
	depends on X86_64
	help
	  Build openSIL, AMD's silicon-initialisation library, from the tree
	  given by TURIN_OPENSIL_PATH with U-Boot's own compiler, and link it
	  into U-Boot. This needs meson, ninja, nasm and python3 on the build
	  machine. U-Boot still sets up the SoC with its own code; for now
	  this only sets up openSIL's debug output and reports the memory it
	  needs, so that the library can be tried out.

config TURIN_OPENSIL_PATH
	string "Path to the openSIL source tree"
	depends on TURIN_OPENSIL
	help
	  The turin_poc branch of https://github.com/openSIL/openSIL, such as
	  src/vendorcode/amd/opensil/turin_poc/opensil in Dasharo's coreboot
	  tree. U-Boot builds it in its own output directory and does not
	  write to the tree. If there is no tree here, the build fails unless
	  OPENSIL_ALLOW_MISSING is set in the environment, as for CI's world
	  builds; it then goes ahead without openSIL, giving a U-Boot which
	  cannot set up the SoC.

config TURIN_OPENSIL_DEBUG
	bool "Show openSIL's messages"
	depends on TURIN_OPENSIL
	help
	  Build openSIL with its trace points enabled, sending its errors and
	  warnings to U-Boot's log as such and the rest at debug levels. This
	  makes the library larger.

config PCIE_ECAM_BASE
	default 0xb0000000
	help
	  The ABL puts the ECAM near the top of the physical address space;
	  U-Boot moves it here, just above the top of low memory, where
	  coreboot also puts it.

endif
```

## board/coreboot/coreboot/Kconfig
```kconfig
if VENDOR_COREBOOT

config SYS_BOARD
	default "coreboot"

config SYS_VENDOR
	default "coreboot"

config SYS_SOC
	default "coreboot"

config TEXT_BASE
	default 0x01110000

config BOARD_SPECIFIC_OPTIONS # dummy
	def_bool y
	select BOARD_EARLY_INIT_R

config COREBOOT_ROM
	bool "Build a complete flash image with U-Boot as the coreboot payload"
	select BINMAN
	help
	  Produce u-boot.rom, a complete flash image, by inserting U-Boot as
	  the payload of a ready-made coreboot image provided in one of the
	  binman input directories (see the coreboot-rom binman entry type).
	  The board's devicetree must describe the image in a binman node.

config SYS_CAR_ADDR
	hex "Board specific Cache-As-RAM (CAR) address"
	default 0x01920000
	help
	  This option specifies the board specific Cache-As-RAM (CAR) address.

config SYS_CAR_SIZE
	hex "Board specific Cache-As-RAM (CAR) size"
	default 0x4000
	help
	  This option specifies the board specific Cache-As-RAM (CAR) size.

endif  # CONFIG_VENDOR_COREBOOT
```

## board/emulation/qemu-arm/Kconfig
```kconfig
if ARCH_QEMU_ARM && !TARGET_QEMU_ARM_SBSA

config BOARD_SPECIFIC_OPTIONS # dummy
	def_bool y
	select HAS_CUSTOM_SYS_INIT_SP_ADDR
	select QFW if ACPI
	select QFW_MMIO if CMD_QFW
	imply SYS_EARLY_PCI_INIT
	imply VIRTIO_MMIO
	imply VIRTIO_PCI
	imply VIRTIO_NET
	imply VIRTIO_BLK
	select SUPPORT_SPL

config PRE_CON_BUF_ADDR
	hex
	default 0x40100000

endif

if TARGET_QEMU_ARM_32BIT || TARGET_QEMU_ARM_64BIT

config PPL_TEXT_BASE
	default 0x00000000

endif

if TARGET_QEMU_ARM_64BIT && !TFABOOT
config BOARD_SPECIFIC_OPTIONS
	imply SYS_MTDPARTS_RUNTIME
	imply SET_DFU_ALT_INFO

endif

if TARGET_QEMU_ARM_32BIT_SPL || TARGET_QEMU_ARM_64BIT_SPL

config SPL_TEXT_BASE
	default 0x00000000

config PPL_TEXT_BASE
	default 0x00010000

config SPL_MAX_SIZE
	default 0x00010000

endif

source "board/emulation/common/Kconfig"
```

## board/gigabyte/Kconfig
```kconfig
# SPDX-License-Identifier: GPL-2.0+
#
# Copyright 2026 Simon Glass <sjg@chromium.org>

if VENDOR_GIGABYTE

choice
	prompt "Mainboard model"
	optional

config TARGET_MZ33_AR1
	bool "Gigabyte MZ33-AR1"
	help
	  Single-socket server board for the AMD EPYC 9005 (Turin) family,
	  with 12 DDR5 DIMM slots, an AST2600 BMC and PCIe Gen5 slots. U-Boot
	  runs on it natively as the 'BIOS' loaded by the PSP.

endchoice

source "board/gigabyte/mz33_ar1/Kconfig"

endif
```

## board/google/chromebook_brya/Kconfig
```kconfig
if TARGET_CHROMEBOOK_BRYA

config SYS_BOARD
	default "chromebook_brya"

config SYS_VENDOR
	default "google"

config SYS_SOC
	default "alderlake"

config SYS_CONFIG_NAME
	default "chromebook_brya"

config TEXT_BASE
	default 0xff100000

config BOARD_SPECIFIC_OPTIONS # dummy
	def_bool y
	select X86_RESET_VECTOR
	select INTEL_ALDERLAKE
	select BOARD_ROMSIZE_KB_32768

config PCIE_ECAM_BASE
	default 0xc0000000

config SYS_CAR_ADDR
	hex
	default 0xfef00000

config SYS_CAR_SIZE
	hex
	default 0xc0000

endif
```

## board/luckfox/pico/Kconfig
```kconfig
if TARGET_LUCKFOX_PICO_RV1103

config SYS_BOARD
	default "pico"

config SYS_VENDOR
	default "luckfox"

config SYS_CONFIG_NAME
	default "luckfox_pico"

endif
```

## board/onion/omega4_rv1103b/Kconfig
```kconfig
if TARGET_OMEGA4_RV1103B

config SYS_BOARD
	default "omega4_rv1103b"

config SYS_VENDOR
	default "onion"

config SYS_CONFIG_NAME
	default "omega4_rv1103b"

endif
```

## configs/chromebook_brya_defconfig
```kconfig
CONFIG_X86=y
CONFIG_TEXT_BASE=0x1110000
CONFIG_SYS_MALLOC_LEN=0x2000000
CONFIG_SYS_MALLOC_F_LEN=0x8000
CONFIG_NR_DRAM_BANKS=8
CONFIG_SMP=y
CONFIG_MAX_CPUS=8
CONFIG_DEFAULT_DEVICE_TREE="chromebook_brya"
CONFIG_TPL_TEXT_BASE=0xfff90000
CONFIG_SPL_SYS_MALLOC_F_LEN=0x20000
CONFIG_SPL_TEXT_BASE=0xfef10000
CONFIG_DEBUG_UART_BASE=0xfe03e000
CONFIG_DEBUG_UART_CLOCK=1843200
CONFIG_DEBUG_UART_BOARD_INIT=y
CONFIG_VENDOR_GOOGLE=y
CONFIG_TARGET_CHROMEBOOK_BRYA=y
CONFIG_DEBUG_UART=y
CONFIG_DEBUG_UART_SHIFT=2
CONFIG_X86_OFFSET_U_BOOT=0xff100000
CONFIG_X86_OFFSET_SPL=0xffd00000
CONFIG_SYS_MONITOR_BASE=0x01110000
# CONFIG_EFI_LOADER is not set
CONFIG_BOOTSTD_FULL=y
CONFIG_BOOTSTAGE=y
CONFIG_SPL_BOOTSTAGE=y
CONFIG_SPL_BOOTSTAGE_RECORD_COUNT=20
CONFIG_BOOTSTAGE_STASH=y
CONFIG_BOOTSTAGE_STASH_ADDR=0x130000
CONFIG_BOOTCOMMAND="tpm2 autostart; bootflow scan -l; bootflow select 0; bootflow cmdline set earlycon uart8250,mmio32,0xfe03e000,115200n8; bootflow cmdline set console ttyS0,115200n8; bootflow cmdline set i915.modeset 0; bootflow cmdline set intel_idle.max_cstate 2; bootflow boot"
CONFIG_SYS_CONSOLE_INFO_QUIET=y
# CONFIG_SYS_MALLOC_CLEAR_ON_INIT is not set
CONFIG_LOG=y
CONFIG_LOGF_FUNC=y
CONFIG_TPL_SYS_MALLOC_F_LEN=0x2600
CONFIG_BLOBLIST=y
CONFIG_BLOBLIST_FIXED=y
CONFIG_BLOBLIST_ADDR=0x100000
CONFIG_BLOBLIST_SIZE=0x30000
# CONFIG_TPL_BLOBLIST is not set
CONFIG_HANDOFF=y
CONFIG_TPL_SERIAL=y
CONFIG_SPL_SERIAL=y
CONFIG_SYS_NS16550=y
CONFIG_SYS_NS16550_MEM32=y
CONFIG_SYSCON=y
CONFIG_SPL_PCI=y
CONFIG_TPL_SIMPLE_BUS=y
CONFIG_TPL_SYSRESET=y
CONFIG_SYSRESET=y
CONFIG_SPL_SYSRESET=y
CONFIG_SYSRESET_X86=y
CONFIG_ENABLE_MRC_CACHE=y
CONFIG_SPL_NO_BSS_LIMIT=y
CONFIG_SPL_SEPARATE_BSS=y
CONFIG_GENERATE_ACPI_TABLE=y
CONFIG_INTEL_ACPIGEN=y
CONFIG_CPU=y
CONFIG_DM_I2C=y
CONFIG_SYS_I2C_DW=y
CONFIG_NVME_PCI=y
CONFIG_SPI=y
CONFIG_SPL_SPI=y
CONFIG_SPL_DM_SPI=y
CONFIG_ICH_SPI=y
CONFIG_SPI_FLASH=y
CONFIG_SPL_SPI_FLASH_SUPPORT=y
CONFIG_SPL_DM_SPI_FLASH=y
# CONFIG_SPL_SPI_FLASH_TINY is not set
CONFIG_SPI_FLASH_WINBOND=y
CONFIG_SPL_PCH=y
CONFIG_PCH=y
CONFIG_PINCTRL=y
CONFIG_PINCTRL_INTEL=y
CONFIG_PINCTRL_INTEL_ALDERLAKE=y
CONFIG_INTEL_GPIO=y
CONFIG_P2SB=y
CONFIG_SPL_PINCTRL=y
CONFIG_SPL_P2SB=y
# CONFIG_ACPIGEN is not set
CONFIG_TPL_P2SB=y
CONFIG_TPL_PINCTRL=y
CONFIG_TPL_DM_GPIO=y
CONFIG_VIDEO_COPY=y
CONFIG_CONSOLE_TRUETYPE=y
CONFIG_CONSOLE_TRUETYPE_SIZE=20
# CONFIG_CONSOLE_TRUETYPE_NIMBUS is not set
CONFIG_CONSOLE_TRUETYPE_ANKACODER=y
CONFIG_CONSOLE_SCROLL_LINES=5
CONFIG_CMD_BOOTSTAGE=y
CONFIG_CMD_TPM=y
# CONFIG_TPM_V1 is not set
CONFIG_TPM2_CR50_I2C=y
CONFIG_TPM=y
CONFIG_SHA256=y
# CONFIG_SPL_SHA256 is not set
```

## configs/gigabyte_mz33_ar1_defconfig
```kconfig
CONFIG_X86=y
CONFIG_PPL_TEXT_BASE=0x7150000
CONFIG_SYS_MALLOC_LEN=0x2000000
CONFIG_NR_DRAM_BANKS=2
CONFIG_ENV_SIZE=0x1000
CONFIG_DEFAULT_DEVICE_TREE="gigabyte_mz33_ar1"
CONFIG_DEBUG_UART_BASE=0x3f8
CONFIG_DEBUG_UART_CLOCK=1843200
CONFIG_X86_RUN_64BIT_NO_SPL=y
CONFIG_VENDOR_GIGABYTE=y
CONFIG_TARGET_MZ33_AR1=y
CONFIG_DEBUG_UART=y
# CONFIG_HAVE_MICROCODE is not set
CONFIG_SYS_MONITOR_BASE=0x07150000
CONFIG_BOOTSTD_FULL=y
CONFIG_SYS_CONSOLE_INFO_QUIET=y
CONFIG_LOG=y
CONFIG_DISPLAY_BOARDINFO_LATE=y
CONFIG_CMD_CPU=y
CONFIG_ENV_OVERWRITE=y
CONFIG_SYSCON=y
CONFIG_CPU=y
CONFIG_DEBUG_UART_ANNOUNCE=y
CONFIG_BOOTMETH_BLS=y
```

## configs/gigabyte_mz33_ar1_opensil_defconfig
```kconfig
CONFIG_X86=y
CONFIG_PPL_TEXT_BASE=0x1110000
CONFIG_SYS_MALLOC_LEN=0x2000000
CONFIG_NR_DRAM_BANKS=2
CONFIG_ENV_SIZE=0x1000
CONFIG_DEFAULT_DEVICE_TREE="gigabyte_mz33_ar1"
CONFIG_SPL_SYS_MALLOC_F_LEN=0x8000
CONFIG_SPL_TEXT_BASE=0x7150000
CONFIG_DEBUG_UART_BASE=0x3f8
CONFIG_DEBUG_UART_CLOCK=1843200
CONFIG_X86_RUN_64BIT=y
CONFIG_VENDOR_GIGABYTE=y
CONFIG_TARGET_MZ33_AR1=y
CONFIG_DEBUG_UART=y
CONFIG_TURIN_OPENSIL=y
# CONFIG_HAVE_MICROCODE is not set
CONFIG_SYS_MONITOR_BASE=0x01110000
CONFIG_BOOTSTD_FULL=y
CONFIG_BOOTMETH_BLS=y
CONFIG_SYS_CONSOLE_INFO_QUIET=y
CONFIG_LOG=y
CONFIG_DISPLAY_BOARDINFO_LATE=y
# CONFIG_SPL_BLOBLIST is not set
CONFIG_SPL_NO_BSS_LIMIT=y
CONFIG_CMD_CPU=y
CONFIG_ENV_OVERWRITE=y
CONFIG_SYSCON=y
CONFIG_CPU=y
CONFIG_DEBUG_UART_ANNOUNCE=y
```
