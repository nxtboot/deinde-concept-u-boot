## configs/rk3399-generic-ddr3_defconfig
```kconfig
CONFIG_ARM=y
CONFIG_SKIP_LOWLEVEL_INIT=y
CONFIG_SPL_SYS_DCACHE_OFF=y
CONFIG_COUNTER_FREQUENCY=24000000
CONFIG_ARCH_ROCKCHIP=y
CONFIG_TEXT_BASE=0x00200000
CONFIG_SPL_LIBCOMMON_SUPPORT=y
CONFIG_NR_DRAM_BANKS=1
CONFIG_HAS_CUSTOM_SYS_INIT_SP_ADDR=y
CONFIG_CUSTOM_SYS_INIT_SP_ADDR=0x3f00000
CONFIG_SF_DEFAULT_SPEED=20000000
CONFIG_ENV_OFFSET=0x3F8000
CONFIG_DEFAULT_DEVICE_TREE="rockchip/rk3399-firefly"
CONFIG_DM_RESET=y
CONFIG_ROCKCHIP_RK3399=y
CONFIG_SPL_STACK_R_ADDR=0x04000000
CONFIG_TARGET_EVB_RK3399=y
CONFIG_SPL_STACK=0xff8eff00
CONFIG_SPL_TEXT_BASE=0xff8c2000
CONFIG_SPL_BSS_MAX_SIZE=0x2000
CONFIG_SPL_STACK_R=y
CONFIG_SPL_STACK_R_MALLOC_SIMPLE_LEN=0x30000
CONFIG_SYS_LOAD_ADDR=0x800800
CONFIG_DEBUG_UART_BASE=0xFF1A0000
CONFIG_DEBUG_UART_CLOCK=24000000
CONFIG_PCI=y
CONFIG_DEBUG_UART=y
CONFIG_SPL_MAX_SIZE=0x40000
CONFIG_FIT_BEST_MATCH=y
# CONFIG_SPL_HAS_LOAD_FIT_ADDRESS is not set
CONFIG_VPL_LOAD_FIT_FULL=y
# CONFIG_VPL_FIT_PRINT is not set
# CONFIG_VPL_FIT_SIGNATURE is not set
# CONFIG_VPL_BOOTSTD is not set
# CONFIG_BOOTMETH_VBE_SIMPLE is not set
CONFIG_BOOTMETH_VBE_ABREC=y
CONFIG_BOOTSTAGE=y
CONFIG_BOOTSTAGE_REPORT=y
CONFIG_USE_PREBOOT=y
CONFIG_DEFAULT_FDT_FILE="rockchip/rk3399-generic.dtb"
CONFIG_LOG=y
CONFIG_DISPLAY_BOARDINFO_LATE=y
CONFIG_BLOBLIST=y
CONFIG_BLOBLIST_FIXED=y
CONFIG_BLOBLIST_ADDR=0xff8eff00
CONFIG_BLOBLIST_SIZE=0x100
# CONFIG_SPL_SHARES_INIT_SP_ADDR is not set
CONFIG_SPL_HAVE_INIT_STACK=y
# CONFIG_SPL_SEPARATE_BSS is not set
CONFIG_SYS_MMCSD_RAW_MODE_U_BOOT_SECTOR=0x1000
CONFIG_SPL_ATF_NO_PLATFORM_PARAM=y
CONFIG_TPL=y
CONFIG_TPL_RELOC_LOADER=y
CONFIG_VPL=y
CONFIG_VPL_RELOC_LOADER=y
CONFIG_CMD_BOOTZ=y
CONFIG_CMD_GPT=y
CONFIG_CMD_MMC=y
CONFIG_CMD_PCI=y
CONFIG_CMD_USB=y
# CONFIG_CMD_SETEXPR is not set
CONFIG_CMD_CACHE=y
CONFIG_CMD_TIME=y
CONFIG_CMD_BOOTSTAGE=y
CONFIG_SPL_OF_CONTROL=y
CONFIG_OF_LIST="rockchip/rk3399-nanopc-t4 rockchip/rk3399-nanopi-m4 rockchip/rk3399-nanopi-m4b rockchip/rk3399-nanopi-neo4 rockchip/rk3399-evb rockchip/rk3399-ficus rockchip/rk3399-firefly rockchip/rk3399-orangepi rockchip/rk3399-puma-haikou"
CONFIG_OF_SPL_REMOVE_PROPS="pinctrl-0 pinctrl-names clock-names interrupt-parent assigned-clocks assigned-clock-rates assigned-clock-parents"
CONFIG_ENV_IS_IN_MMC=y
CONFIG_TPL_DM_SEQ_ALIAS=y
CONFIG_VPL_SYSCON=y
CONFIG_SPL_CLK=y
CONFIG_ROCKCHIP_GPIO=y
CONFIG_SYS_I2C_ROCKCHIP=y
CONFIG_MMC_DW=y
CONFIG_MMC_DW_ROCKCHIP=y
CONFIG_MMC_DW_ROCKCHIP_CLK_HANDOFF=y
CONFIG_MMC_SDHCI=y
CONFIG_MMC_SDHCI_SDMA=y
CONFIG_MMC_SDHCI_ROCKCHIP=y
CONFIG_DM_ETH_PHY=y
CONFIG_ETH_DESIGNWARE=y
CONFIG_GMAC_ROCKCHIP=y
CONFIG_PHY_REALTEK=y
CONFIG_NVME_PCI=y
CONFIG_PHY_ROCKCHIP_INNO_USB2=y
CONFIG_PHY_ROCKCHIP_TYPEC=y
# CONFIG_SPL_DM_PMIC is not set
CONFIG_PMIC_RK8XX=y
CONFIG_REGULATOR_PWM=y
CONFIG_REGULATOR_RK8XX=y
CONFIG_PWM_ROCKCHIP=y
CONFIG_BAUDRATE=1500000
CONFIG_DEBUG_UART_SHIFT=2
CONFIG_SYS_NS16550_MEM32=y
CONFIG_SYSRESET=y
# CONFIG_VPL_SYSRESET is not set
CONFIG_USB=y
# CONFIG_SPL_DM_USB is not set
CONFIG_USB_XHCI_HCD=y
CONFIG_USB_EHCI_HCD=y
CONFIG_USB_EHCI_GENERIC=y
CONFIG_USB_DWC3=y
CONFIG_USB_DWC3_GENERIC=y
CONFIG_USB_HOST_ETHER=y
CONFIG_USB_ETHER_ASIX=y
CONFIG_USB_ETHER_ASIX88179=y
CONFIG_USB_ETHER_MCS7830=y
CONFIG_USB_ETHER_RTL8152=y
CONFIG_USB_ETHER_SMSC95XX=y
CONFIG_VIDEO=y
CONFIG_DISPLAY=y
CONFIG_VIDEO_ROCKCHIP=y
CONFIG_DISPLAY_ROCKCHIP_HDMI=y
CONFIG_VPL_USE_TINY_PRINTF=y
CONFIG_SPL_TINY_MEMSET=y
CONFIG_CMD_DHRYSTONE=y
# CONFIG_SPL_SHA1 is not set
# CONFIG_VPL_SHA1 is not set
# CONFIG_VPL_SHA256 is not set
CONFIG_TPL_CRC8=y
CONFIG_TPL_LZ4=y
CONFIG_VPL_LZ4=y
# CONFIG_VPL_LZMA is not set
CONFIG_ERRNO_STR=y
```

## configs/spacemit_k1_defconfig
```kconfig
CONFIG_RISCV=y
CONFIG_SYS_MALLOC_LEN=0x1000000
CONFIG_SYS_MALLOC_F_LEN=0x5000
CONFIG_NR_DRAM_BANKS=2
CONFIG_HAS_CUSTOM_SYS_INIT_SP_ADDR=y
CONFIG_CUSTOM_SYS_INIT_SP_ADDR=0x1000000
CONFIG_DEFAULT_DEVICE_TREE="spacemit/k1-bananapi-f3"
CONFIG_SPL_STACK=0xc0840000
CONFIG_SPL_TEXT_BASE=0xc0801000
CONFIG_SPL_BSS_START_ADDR=0xc0837000
CONFIG_SPL_BSS_MAX_SIZE=0x2000
CONFIG_SYS_BOOTM_LEN=0xa000000
CONFIG_SYS_LOAD_ADDR=0x200000
CONFIG_SPL_SIZE_LIMIT=0x31000
CONFIG_SPL=y
CONFIG_DEBUG_UART_BASE=0xd4017000
CONFIG_DEBUG_UART_CLOCK=14700000
CONFIG_TARGET_SPACEMIT_K1=y
CONFIG_ARCH_RV64I=y
CONFIG_RISCV_SMODE=y
CONFIG_SPL_RISCV_SMODE=y
CONFIG_SPL_MAX_SIZE=0x33000
CONFIG_STACK_SIZE=0x100000
CONFIG_FIT=y
CONFIG_SPL_FIT_SIGNATURE=y
CONFIG_SPL_LOAD_FIT_ADDRESS=0x08000000
CONFIG_SUPPORT_RAW_INITRD=y
CONFIG_OF_BOARD_SETUP=y
CONFIG_SYS_CBSIZE=256
CONFIG_SYS_PBSIZE=276
CONFIG_LOG=y
# CONFIG_BOARD_INIT is not set
# CONFIG_SPL_SHARES_INIT_SP_ADDR is not set
CONFIG_SPL_HAVE_INIT_STACK=y
CONFIG_SPL_SYS_MALLOC=y
CONFIG_SPL_HAS_CUSTOM_MALLOC_START=y
CONFIG_SPL_CUSTOM_SYS_MALLOC_ADDR=0x04000000
CONFIG_SPL_SYS_MALLOC_SIZE=0x1000000
CONFIG_SPL_ENV_SUPPORT=y
CONFIG_SPL_I2C=y
CONFIG_SPL_DM_RESET=y
CONFIG_SPL_POWER=y
CONFIG_SPL_RAM_DEVICE=y
CONFIG_HUSH_PARSER=y
CONFIG_CMD_TLV_EEPROM=y
CONFIG_SPL_CMD_TLV_EEPROM=y
CONFIG_CMD_DFU=y
CONFIG_OF_UPSTREAM=y
CONFIG_ENV_OVERWRITE=y
CONFIG_SPL_CLK=y
CONFIG_SPL_CLK_CCF=y
CONFIG_CLK_SPACEMIT=y
CONFIG_CLK_SPACEMIT_K1=y
CONFIG_DFU_RAM=y
CONFIG_SYS_DFU_DATA_BUF_SIZE=0x100000
CONFIG_DM_I2C=y
CONFIG_SYS_I2C_SPACEMIT_K1=y
CONFIG_MISC=y
CONFIG_I2C_EEPROM=y
CONFIG_SPL_I2C_EEPROM=y
CONFIG_PINCTRL=y
CONFIG_PINCTRL_SINGLE=y
CONFIG_DM_PMIC=y
CONFIG_PMIC_SPACEMIT_P1=y
CONFIG_DM_REGULATOR=y
CONFIG_SPL_DM_REGULATOR=y
CONFIG_DM_REGULATOR_SPACEMIT_P1=y
CONFIG_DEBUG_UART_NS16550=y
CONFIG_DEBUG_UART_SHIFT=2
CONFIG_SYS_NS16550=y
CONFIG_SYS_NS16550_MEM32=y
CONFIG_TIMER_EARLY=y
CONFIG_USB=y
CONFIG_USB_GADGET=y
CONFIG_SPL_USB_GADGET=y
CONFIG_USB_GADGET_MANUFACTURER="SpacemiT"
CONFIG_USB_GADGET_VENDOR_NUM=0x361c
CONFIG_USB_GADGET_PRODUCT_NUM=0x1001
CONFIG_K1X_USB2_CI=y
CONFIG_USB_GADGET_DOWNLOAD=y
CONFIG_SPL_DFU=y
CONFIG_SPL_LIB_RATIONAL=y
```

## configs/vexpress_fvp_bloblist_defconfig
```kconfig
CONFIG_ARM=y
# CONFIG_ARM64_CRC32 is not set
CONFIG_ARCH_VEXPRESS64=y
CONFIG_BLOBLIST_SIZE_RELOC=0x10000
CONFIG_DEFAULT_DEVICE_TREE="arm_fvp"
CONFIG_IDENT_STRING=" arm_fvp"
# CONFIG_DISPLAY_CPUINFO is not set
CONFIG_OF_LIBFDT_OVERLAY=y
CONFIG_BLOBLIST=y
CONFIG_BLOBLIST_PASSAGE=y
CONFIG_PASSAGE_IN=y
CONFIG_OF_PASSAGE=y
```

## drivers/debug/Kconfig
```kconfig
config DEBUG_DEV
	bool "Devices which can show debug output"
	depends on DM
	help
	  Enable a uclass for devices which can get a message out of U-Boot
	  without using the console. These are called explicitly from code
	  being debugged, rather than being wired up as a console, so they
	  work even when the console is unavailable or is itself the thing
	  under investigation.

if DEBUG_DEV

config DEBUG_DEV_ANNOUNCE
	bool "Announce debug devices when they are probed"
	select EVENT
	help
	  Write a short message to each debug device as it is probed, naming
	  the device. This shows that the device is working, which is worth
	  knowing before concluding that the code under investigation is the
	  thing which is silent.

	  Debug devices are probed at the end of init when this is enabled, so
	  the message appears without anything having to call debug_puts().
	  This is left until then because a debug device may sit on a bus which
	  is not usable any earlier.

config DEBUG_EM100
	bool "Debug output through a Dediprog EM100Pro"
	depends on DM_SPI
	help
	  Send debug output to a Dediprog EM100Pro emulating the boot flash.
	  The emulator watches the SPI bus for a command which is not a flash
	  access and passes what follows to the host, where it is shown by
	  'em100 --terminal'. This needs no wiring beyond the flash connection
	  which is already there, so it is useful on boards with no usable
	  UART.

config DEBUG_SANDBOX
	bool "Sandbox debug device"
	depends on SANDBOX
	default y if SANDBOX
	help
	  Provide a debug device for sandbox, which records what is written
	  to it so that tests can check it.

endif
```

## drivers/video/fonts/Kconfig
```kconfig
#
# Video fonts
#

if CONSOLE_TRUETYPE

menu "TrueType Fonts"

config CONSOLE_TRUETYPE_NIMBUS
	bool "Nimbus Sans Regular"
	default y
	help
	  Nimbus Sans L is a version of Nimbus Sans using Adobe font sources.
	  It was designed in 1987. A subset of Nimbus Sans L were released
	  under the GPL. Although the characters are not exactly the same,
	  Nimbus Sans L has metrics almost identical to Helvetica and Arial.
	  (From Wikipedia, the free encyclopedia)
	  From: https://fontlibrary.org/en/font/nimbus-sans-l
	  License: GNU GPL v3
	  http://www.gnu.org/copyleft/gpl.html

config CONSOLE_TRUETYPE_ANKACODER
	bool "Anka Coder Narrow"
	help
	  The Anka/Coder family is a monospaced, courier-width font for source
	  code and terminals, in two styles and weights. Anka/Coder Narrow was
	  developed for printing source code.
	  https://code.google.com/p/anka-coder-fonts/
	  From: https://fontlibrary.org/en/font/anka-coder-narrow
	  License: SIL Open Font Licence
	  http://scripts.sil.org/cms/scripts/page.php?site_id=nrsi&id=OFL

config CONSOLE_TRUETYPE_RUFSCRIPT
	bool "Ruf Script"
	help
	  A laid-back handwritten font.
	  Font: https://fontlibrary.org/en/font/rufscript
	  License: GPL with font exception
	  http://www.gnu.org/copyleft/gpl.html

config CONSOLE_TRUETYPE_CANTORAONE
	bool "Cantoraone"
	help
	  Cantora is a friendly semi formal, semi condensed, semi sans-serif
	  with a hint of handwriting. Perfect for headlines.
	  From https://fontlibrary.org/en/font/cantora
	  License: SIL Open Font Licence
	  http://scripts.sil.org/cms/scripts/page.php?site_id=nrsi&id=OFL

config CONSOLE_TRUETYPE_UBUNTU_LIGHT
	bool "Ubuntu Light"
	help
	  The Ubuntu Font Family are a set of matching libre/open fonts
	  developed in 2010-2011, funded by Canonical Ltd on behalf the wider
	  Free Software community and the Ubuntu project. The technical font
	  design work and implementation was undertaken by Dalton Maag.

	  From https://fonts.google.com/specimen/Ubuntu
	  License: Ubuntu Font Licence version 1.0
	  https://canonical.com/legal/font-licence

config CONSOLE_TRUETYPE_UBUNTU_BOLD
	bool "Ubuntu Bold"
	help
	  The Ubuntu Font Family are a set of matching libre/open fonts
	  developed in 2010-2011, funded by Canonical Ltd on behalf the wider
	  Free Software community and the Ubuntu project. The technical font
	  design work and implementation was undertaken by Dalton Maag.

	  From https://fonts.google.com/specimen/Ubuntu
	  License: Ubuntu Font Licence version 1.0
	  https://canonical.com/legal/font-licence

config CONSOLE_TRUETYPE_DEJAVU
	bool "DejaVu Sans Mono Regular"
	help
	  This mono spaced font contains all code page 437 characters.
	  From https://sourceforge.net/projects/dejavu/
	  License: DejaVu Font License

endmenu

endif  # CONSOLE_TRUETYPE
```

## fs/Kconfig
```kconfig
#
# File system configuration
#

menu "File systems"

config FS
	bool "Support for filesystems"
	default y if SANDBOX || ARCH_QEMU_X86 || ARCH_QEMU_ARM
	depends on EXPERT
	help
	  Provides an interface for filesystems, allowing them to be
	  persistently mounted. Filesystem can contain files and directory.

config SPL_FS
	bool "Support for filesystems in SPL"
	depends on SPL
	help
	  Provides the filesystem uclass in SPL, allowing filesystems to be
	  persistently mounted. This is not normally needed in SPL, which
	  typically loads U-Boot from a raw offset or a single filesystem
	  without the uclass. It is disabled by default, so the fs uclass
	  Makefile rule can use the per-phase CONFIG symbol like other
	  options.

config DIR
	bool "Support for directories"
	depends on FS
	default y if SANDBOX || ARCH_QEMU_X86 || ARCH_QEMU_ARM
	help
	  Provides an interface for directories within filesystems, allowing
	  them to be listed.

config FILE
	bool "Support for files"
	default y if SANDBOX || ARCH_QEMU_X86 || ARCH_QEMU_ARM
	help
	  Provides an interface for files, allowing them to be opened, read,
	  written and modified. Files are children of a filesystem device
	  (UCLASS_FS). Note that a UCLASS_FILE device is only created when it
	  is opened.

config VFS
	bool "Virtual filesystem support"
	depends on FS && DIR
	select EVENT
	help
	  Provides a virtual filesystem layer with a mount table and
	  unified path namespace. Includes a root filesystem at "/".

config FS_LINUX
	bool
	help
	  Common Linux VFS compatibility functions shared by Linux-ported
	  filesystem drivers (ext4l, isofs). Selected automatically when
	  any Linux-ported FS is enabled.

config FS_LEGACY
	def_bool y
	help
	  Enables legacy support for filesystems. This provides an interface
	  which can talk to one filesystem at a time, with the filesystem being
	  re-mounted on each operation.

config SPL_FS_LEGACY
	bool
	depends on SPL
	help
	  Enables legacy support for filesystems in SPL. This provides an
	  interface which can talk to one filesystem at a time, with the
	  filesystem being re-mounted on each operation.

source "fs/btrfs/Kconfig"

source "fs/cbfs/Kconfig"

source "fs/exfat/Kconfig"

source "fs/ext4/Kconfig"

source "fs/ext4l/Kconfig"

source "fs/fat/Kconfig"

source "fs/isofs/Kconfig"

source "fs/jffs2/Kconfig"

source "fs/sandbox/Kconfig"

source "fs/ubifs/Kconfig"

source "fs/cramfs/Kconfig"

source "fs/squashfs/Kconfig"

source "fs/erofs/Kconfig"

endmenu
```
