// SPDX-License-Identifier: GPL-2.0+

/dts-v1/;

/ {
	#address-cells = <1>;
	#size-cells = <1>;

	binman {
		amd-fw {
			amd,soc = "turin";
			amd,spi-read-mode = <0>;
			amd,spi-speed = <0>;
			amd,espi-config = <0x0e 0xff>;

			u-boot {
				amd,psp-type = <0x01>;
			};
		};
	};
};
