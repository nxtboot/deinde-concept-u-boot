// SPDX-License-Identifier: GPL-2.0+

/dts-v1/;

/ {
	#address-cells = <1>;
	#size-cells = <1>;

	binman {
		amd-fw {
			amd,soc = "turin";
			amd,spi-read-mode = <0>;
			amd,spi-speed = <0>;

			nvram {
				amd,psp-type = <0x38>;
				amd,region = <0x80000>;
			};
		};
	};
};
